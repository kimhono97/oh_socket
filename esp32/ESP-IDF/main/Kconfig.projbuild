## esp32/ESP-IDF/main/Kconfig.projbuild
```kconfig
menu "OH-Socket-ESP32 Configuration"

    config ESP_WIFI_SSID
        string "WiFi SSID"
        default "myssid"
        help
            SSID (network name) for the example to connect to.

    config ESP_WIFI_PASSWORD
        string "WiFi Password"
        default "mypassword"
        help
            WiFi password (WPA or WPA2) for the example to use.

    choice ESP_WIFI_SAE_MODE
        prompt "WPA3 SAE mode selection"
        default ESP_WPA3_SAE_PWE_BOTH
        help
            Select mode for SAE as Hunt and Peck, H2E or both.
        config ESP_WPA3_SAE_PWE_HUNT_AND_PECK
            bool "HUNT AND PECK"
        config ESP_WPA3_SAE_PWE_HASH_TO_ELEMENT
            bool "H2E"
        config ESP_WPA3_SAE_PWE_BOTH
            bool "BOTH"
    endchoice

    config ESP_WIFI_PW_ID
        string "PASSWORD IDENTIFIER"
        depends on  ESP_WPA3_SAE_PWE_HASH_TO_ELEMENT|| ESP_WPA3_SAE_PWE_BOTH
        default ""
        help
            password identifier for SAE H2E

    config ESP_MAXIMUM_RETRY
        int "Maximum retry"
        default 5
        help
            Set the Maximum retry to avoid station reconnecting to the AP unlimited when the AP is really inexistent.

    choice ESP_WIFI_SCAN_AUTH_MODE_THRESHOLD
        prompt "WiFi Scan auth mode threshold"
        default ESP_WIFI_AUTH_WPA2_PSK
        help
            The weakest authmode to accept in the scan mode.
            This value defaults to ESP_WIFI_AUTH_WPA2_PSK incase password is present and ESP_WIFI_AUTH_OPEN is used.
            Please select ESP_WIFI_AUTH_WEP/ESP_WIFI_AUTH_WPA_PSK incase AP is operating in WEP/WPA mode.

        config ESP_WIFI_AUTH_OPEN
            bool "OPEN"
        config ESP_WIFI_AUTH_WEP
            bool "WEP"
        config ESP_WIFI_AUTH_WPA_PSK
            bool "WPA PSK"
        config ESP_WIFI_AUTH_WPA2_PSK
            bool "WPA2 PSK"
        config ESP_WIFI_AUTH_WPA_WPA2_PSK
            bool "WPA/WPA2 PSK"
        config ESP_WIFI_AUTH_WPA3_PSK
            bool "WPA3 PSK"
        config ESP_WIFI_AUTH_WPA2_WPA3_PSK
            bool "WPA2/WPA3 PSK"
        config ESP_WIFI_AUTH_WAPI_PSK
            bool "WAPI PSK"
    endchoice

    config GPIO_OUTPUT_DATA0
        int "GPIO output pin output data bit 0"
        range 18 23
        default 18
        help
            GPIO pin number to be used as GPIO_OUTPUT_DATA0.
    config GPIO_OUTPUT_DATA1
        int "GPIO output pin output data bit 1"
        range 18 23
        default 19
        help
            GPIO pin number to be used as GPIO_OUTPUT_DATA1.
    config GPIO_OUTPUT_DATA2
        int "GPIO output pin output data bit 2"
        range 18 23
        default 21
        help
            GPIO pin number to be used as GPIO_OUTPUT_DATA2.
    config GPIO_OUTPUT_DATA3
        int "GPIO output pin output data bit 3"
        range 18 23
        default 22
        help
            GPIO pin number to be used as GPIO_OUTPUT_DATA3.
    config GPIO_OUTPUT_CLOCK
        int "GPIO output pin output data clock"
        range 18 23
        default 23
        help
            GPIO pin number to be used as GPIO_OUTPUT_CLOCK.
    
    config GCOV_ENABLED
        bool "Coverage analyzer"
        default n
        help
            Enables coverage analyzing for host tests.
    config WEBSOCKET_URI
        string "Websocket endpoint URI"
        default "ws://172.30.1.71:3000"
        help
            URL of websocket endpoint this example connects to and sends echo
    config WEBSOCKET_ROOM
        string "Websocket room name"
        default "esp32"
        help
            Room name to join in websocket

    config GPIO_OUTPUT_DSTROBE
        int "GPIO output pin display strobe"
        range 0 2
        default 0
        help
            GPIO pin number to be used as GPIO_OUTPUT_DSTROBE.
    config GPIO_OUTPUT_DCLOCK
        int "GPIO output pin display clock"
        range 0 2
        default 1
        help
            GPIO pin number to be used as GPIO_OUTPUT_DCLOCK.
    config GPIO_OUTPUT_DDATA
        int "GPIO output pin display data"
        range 0 2
        default 2
        help
            GPIO pin number to be used as GPIO_OUTPUT_DDATA.

endmenu
```
